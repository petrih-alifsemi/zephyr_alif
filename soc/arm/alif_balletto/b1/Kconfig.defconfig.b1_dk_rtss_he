## soc/arm/alif_balletto/b1/Kconfig.defconfig.b1_dk_rtss_he
```kconfig
# Copyright (c) 2024 Alif Semiconductor
#
# SPDX-License-Identifier: Apache-2.0

if SOC_B1_DK_RTSS_HE

config SOC
	default "Balletto"

config NUM_IRQS
	default 480

config SYS_CLOCK_HW_CYCLES_PER_SEC
	default 160000000

config USE_DYNAMIC_CLOCK_ADJUSTMENT
	bool "Use dynamic clock adjustment test"
	default n

endif # SOC_B1_DK_RTSS_HE
```
